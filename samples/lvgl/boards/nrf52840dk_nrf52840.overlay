/*
 * Copyright (c) 2025 Noah Luskey <noah@xv.engineering>
 *
 * SPDX-License-Identifier: MIT
 */

/ {
    chosen {
        zephyr,display = &terminal_display;
        /delete-property/ zephyr,console;
    };

    terminal_display: terminal-display {
        status = "okay";
        compatible = "xv,terminal-display";
        terminal = <&uart0>;
        width = <64>;
        height = <64>;
    };
};

/* Default UART baud rate is 115200. Set it to the maximum, 1M */
&uart0 {
    current-speed = <1000000>;
};
