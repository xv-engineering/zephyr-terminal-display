## drivers/Kconfig
```kconfig
# Copyright (c) 2025 Noah Luskey <noah@xv.engineering>
#
# SPDX-License-Identifier: MIT
rsource "terminal_display/Kconfig"
```

## drivers/terminal_display/Kconfig
```kconfig
# Copyright (c) 2025 Noah Luskey <noah@xv.engineering>
#
# SPDX-License-Identifier: MIT

config TERMINAL_DISPLAY
    bool "Terminal Display Driver"
    default y
    depends on DT_HAS_XV_TERMINAL_DISPLAY_ENABLED
    # TODO: probably depends on some sort of console/terminal being enabled
    help
        Enable the terminal display driver.

if TERMINAL_DISPLAY

config TERMINAL_DISPLAY_INIT_PRIORITY
    int "Terminal Display Initialization Priority"
    default 50
    help
        The priority of the Terminal Display initialization.

config TERMINAL_DISPLAY_THREAD_PRIORITY
    int "Terminal Display Thread Priority"
    default 4
    help
        The priority of the Terminal Display thread.

module = TERMINAL_DISPLAY
module-str = terminal_display
source "subsys/logging/Kconfig.template.log_config"

endif
```

## dts/bindings/xv,terminal-display.yaml
```yaml
# Copyright (c) 2025 Noah Luskey <noah@xv.engineering>
#
# SPDX-License-Identifier: MIT
description: Terminal Display Device

compatible: "xv,terminal-display"

include: display-controller.yaml

properties:
  terminal:
    type: phandle
    required: true
    description: |
      The terminal device to output to
```

## samples/direct-draw/sample.yaml
```yaml
sample:
  description: Directly drawing to the display device
  name: terminal-display direct draw sample
tests:
  terminal-display.samples.direct-draw:
    build_only: true
    platform_allow:
      - native_sim/native/64
      - nrf52840dk/nrf52840
```

## samples/lvgl/Kconfig
```kconfig
# Copyright (c) 2025 Noah Luskey <noah@xv.engineering>
#
# SPDX-License-Identifier: MIT
module = SAMPLE
module-str = sample
source "subsys/logging/Kconfig.template.log_config"

config PHYSICS_UPDATE_PERIOD_MS
    int "Physics update period"
    default 33
    # Important: the lower range of 10 is due to some fixed point truncation
    # in the particle physics. If a faster update period is desired, that
    # must be improved first.
    range 10 300

config NUM_PARTICLES
    int "Number of particles"
    default 20
    range 0 40
    help
        This is limited by the LVGL heap size. Be careful
        if increasing this config and/or reducing the heap size.

source "Kconfig.zephyr"
```

## samples/lvgl/boards/nrf52840dk_nrf52840.conf
```kconfig
# Copyright (c) 2025 Noah Luskey <noah@xv.engineering>
#
# SPDX-License-Identifier: MIT
CONFIG_CONSOLE=n
CONFIG_NUM_PARTICLES=15
CONFIG_PHYSICS_UPDATE_PERIOD_MS=100
```

## samples/lvgl/sample.yaml
```yaml
# Copyright (c) 2025 Noah Luskey <noah@xv.engineering>
#
# SPDX-License-Identifier: MIT
sample:
  description: Using LVGL to draw to the display device
  name: terminal-display lvgl sample
tests:
  terminal-display.samples.lvgl:
    build_only: true
    platform_allow:
      - native_sim/native/64
      - nrf52840dk/nrf52840
```

## tests/circle/Kconfig
```kconfig
# Copyright (c) 2025 Noah Luskey <noah@xv.engineering>
#
# SPDX-License-Identifier: MIT

module = TEST
module-str = test
source "subsys/logging/Kconfig.template.log_config"

source "Kconfig.zephyr"
```

## tests/lvgl/Kconfig
```kconfig
module = TEST
module-str = test
source "subsys/logging/Kconfig.template.log_config"

source "Kconfig.zephyr"
```

## west.yml
```yaml
manifest:
  defaults:
    remote: zephyr

  remotes:
    - name: zephyr
      url-base: https://github.com/zephyrproject-rtos/
  
  projects:
    - name: zephyr
      remote: zephyr
      import: true
      revision: v4.1.0

  self:
    path: terminal-display
```
