/*
 * Copyright (c) 2025 Noah Luskey <noah@xv.engineering>
 *
 * SPDX-License-Identifier: Apache-2.0
 */

/ {
    chosen {
        zephyr,display = &terminal_display;
    };

    terminal_display: terminal-display {
        status = "okay";
        compatible = "xv,terminal-display";
        terminal = <&uart1>;
        width = <64>;
        height = <64>;
    };
};

&sdl_dc {
    status = "disabled";
};